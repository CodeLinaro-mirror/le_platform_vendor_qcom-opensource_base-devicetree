// SPDX-License-Identifier: BSD-3-Clause
/*
 * Copyright (c) 2024 Qualcomm Innovation Center, Inc. All rights reserved.
 */

#include "qam8797p.dtsi"

/ {
	compatible = "qcom,sa8797p-adp","qcom,sa8797p";
	qcom,msm-id = <648 0x10000>, <648 0x10001>, <690 0x10000>, <690 0x10001>;
};
