// SPDX-License-Identifier: BSD-3-Clause
/*
 * Copyright (c) Qualcomm Technologies, Inc. and/or its subsidiaries.
 */

/dts-v1/;
/plugin/;

#include "sa8x97p-flex-ddr-64gb-vms.dtsi"

&non_ecc_heap_mem {
	reg = <0x8C 0x80000000 0x1 0x00000000>;
	status = "okay";
};
