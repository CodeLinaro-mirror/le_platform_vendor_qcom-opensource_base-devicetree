// SPDX-License-Identifier: BSD-3-Clause
/*
 * Copyright (c) Qualcomm Technologies, Inc. and/or its subsidiaries.
 */

/dts-v1/;

#include "sa8x97p.dtsi"
#include "sa8x97p-v2.dtsi"
#include "sa8797p.dtsi"
#include "sa8x97p-pats.dtsi"

/ {
	model = "Qualcomm Technologies, Inc. SA8797P v2 QAM PATS";
	compatible = "qcom,sa8797p-qam-ride-sx", "qcom,sa8797p-qam", "qcom,sa8797p";
	qcom,msm-id = <690 0x20000>;
	qcom,board-id = <0x03010025 3>;
	qcom,sku-id = <0x100>;
};
