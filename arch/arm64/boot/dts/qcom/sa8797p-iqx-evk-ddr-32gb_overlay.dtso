// SPDX-License-Identifier: BSD-3-Clause
/*
 * Copyright (c) Qualcomm Technologies, Inc. and/or its subsidiaries.
 */

/dts-v1/;
/plugin/;

/ {
	compatible = "qcom,sa8797p-iqx-evk";
};

&{/} {
	qcom,sku-id = <0x1>;
};

&non_ecc_heap_mem {
	reg = <0xA 0x20000000 0x1 0x3F000000>;
	status = "okay";
};
