// SPDX-License-Identifier: BSD-3-Clause
/*
 * Copyright (c) Qualcomm Technologies, Inc. and/or its subsidiaries.
 */

/dts-v1/;

#include "seca.dtsi"

/ {
	model = "Qualcomm Technologies, Inc. SECA QAM RIDE-SX";
	compatible = "qcom,seca-ride-sx", "qcom,seca";
	qcom,board-id = <0x01010025 1>;
	qcom,sku-id = <0x100>;
};
