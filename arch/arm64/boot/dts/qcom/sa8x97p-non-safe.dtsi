// SPDX-License-Identifier: BSD-3-Clause
/*
 * Copyright (c) Qualcomm Technologies, Inc. and/or its subsidiaries.
 */

/ {
	compatible = "qcom,sa8x97p-non-safe","qcom,non-safe";
};

#include <dt-bindings/thermal/thermal.h>

&CPU0 {
	#cooling-cells = <2>;
};

&CPU1 {
	#cooling-cells = <2>;
	CPU1_idle: thermal-idle {
		#cooling-cells = <2>;
		duration-us = <800000>;
		exit-latency-us = <10000>;
	};
};

&CPU2 {
	#cooling-cells = <2>;
	CPU2_idle: thermal-idle {
		#cooling-cells = <2>;
		duration-us = <800000>;
		exit-latency-us = <10000>;
	};
};

&CPU3 {
	#cooling-cells = <2>;
	CPU3_idle: thermal-idle {
		#cooling-cells = <2>;
		duration-us = <800000>;
		exit-latency-us = <10000>;
	};
};

&CPU4 {
	#cooling-cells = <2>;
	CPU4_idle: thermal-idle {
		#cooling-cells = <2>;
		duration-us = <800000>;
		exit-latency-us = <10000>;
	};
};

&CPU5 {
	#cooling-cells = <2>;
	CPU5_idle: thermal-idle {
		#cooling-cells = <2>;
		duration-us = <800000>;
		exit-latency-us = <10000>;
	};
};

&CPU6 {
	#cooling-cells = <2>;
	CPU6_idle: thermal-idle {
		#cooling-cells = <2>;
		duration-us = <800000>;
		exit-latency-us = <10000>;
	};
};

&CPU7 {
	#cooling-cells = <2>;
	CPU7_idle: thermal-idle {
		#cooling-cells = <2>;
		duration-us = <800000>;
		exit-latency-us = <10000>;
	};
};

&CPU8 {
	#cooling-cells = <2>;
	CPU8_idle: thermal-idle {
		#cooling-cells = <2>;
		duration-us = <800000>;
		exit-latency-us = <10000>;
	};
};

&CPU9 {
	#cooling-cells = <2>;
	CPU9_idle: thermal-idle {
		#cooling-cells = <2>;
		duration-us = <800000>;
		exit-latency-us = <10000>;
	};
};

&CPU10 {
	#cooling-cells = <2>;
	CPU10_idle: thermal-idle {
		#cooling-cells = <2>;
		duration-us = <800000>;
		exit-latency-us = <10000>;
	};
};

&CPU11 {
	#cooling-cells = <2>;
	CPU11_idle: thermal-idle {
		#cooling-cells = <2>;
		duration-us = <800000>;
		exit-latency-us = <10000>;
	};
};

&CPU12 {
	#cooling-cells = <2>;
	CPU12_idle: thermal-idle {
		#cooling-cells = <2>;
		duration-us = <800000>;
		exit-latency-us = <10000>;
	};
};

&CPU13 {
	#cooling-cells = <2>;
	CPU13_idle: thermal-idle {
		#cooling-cells = <2>;
		duration-us = <800000>;
		exit-latency-us = <10000>;
	};
};

&CPU14 {
	#cooling-cells = <2>;
	CPU14_idle: thermal-idle {
		#cooling-cells = <2>;
		duration-us = <800000>;
		exit-latency-us = <10000>;
	};
};

&CPU15 {
	#cooling-cells = <2>;
	CPU15_idle: thermal-idle {
		#cooling-cells = <2>;
		duration-us = <800000>;
		exit-latency-us = <10000>;
	};
};

&CPU16 {
	#cooling-cells = <2>;
	CPU16_idle: thermal-idle {
		#cooling-cells = <2>;
		duration-us = <800000>;
		exit-latency-us = <10000>;
	};
};

&CPU17 {
	#cooling-cells = <2>;
	CPU17_idle: thermal-idle {
		#cooling-cells = <2>;
		duration-us = <800000>;
		exit-latency-us = <10000>;
	};
};

&thermal_zones {
	ddr-0-0 {
		trips {
			trip-point2 {
				temperature = <115000>;
				hysteresis = <3000>;
				type = "critical";
			};
		};
	};

	cpu-0-0-0 {
		trips {
			trip-point2 {
				temperature = <115000>;
				hysteresis = <3000>;
				type = "critical";
			};
		};
	};

	cpu-0-1-0 {
		trips {
			trip-point2 {
				temperature = <115000>;
				hysteresis = <3000>;
				type = "critical";
			};

			cpu1_alert0: trip-point1 {
				temperature = <114000>;
				hysteresis = <3000>;
			};
		};

		cooling-maps {
			map0 {
				trip = <&cpu1_alert0>;
				cooling-device = <&CPU1_idle 100 100>;
			};
		};
	};

	cpu-0-2-0 {
		trips {
			trip-point2 {
				temperature = <115000>;
				hysteresis = <3000>;
				type = "critical";
			};

			cpu2_alert0: trip-point1 {
				temperature = <114000>;
				hysteresis = <3000>;
			};
		};

		cooling-maps {
			map0 {
				trip = <&cpu2_alert0>;
				cooling-device = <&CPU2_idle 100 100>;
			};
		};
	};

	cpu-0-3-0 {
		trips {
			trip-point2 {
				temperature = <115000>;
				hysteresis = <3000>;
				type = "critical";
			};

			cpu3_alert0: trip-point1 {
				temperature = <114000>;
				hysteresis = <3000>;
			};
		};

		cooling-maps {
			map0 {
				trip = <&cpu3_alert0>;
				cooling-device = <&CPU3_idle 100 100>;
			};
		};
	};

	cpu-0-4-0 {
		trips {
			trip-point2 {
				temperature = <115000>;
				hysteresis = <3000>;
				type = "critical";
			};

			cpu4_alert0: trip-point1 {
				temperature = <114000>;
				hysteresis = <3000>;
			};
		};

		cooling-maps {
			map0 {
				trip = <&cpu4_alert0>;
				cooling-device = <&CPU4_idle 100 100>;
			};
		};
	};

	cpu-0-5-0 {
		trips {
			trip-point2 {
				temperature = <115000>;
				hysteresis = <3000>;
				type = "critical";
			};

			cpu5_alert0: trip-point1 {
				temperature = <114000>;
				hysteresis = <3000>;
			};
		};

		cooling-maps {
			map0 {
				trip = <&cpu5_alert0>;
				cooling-device = <&CPU5_idle 100 100>;
			};
		};
	};

	cpullc-0-0 {
		trips {
			trip-point2 {
				temperature = <115000>;
				hysteresis = <3000>;
				type = "critical";
			};
		};
	};

	cpu-1-0-0 {
		trips {
			trip-point2 {
				temperature = <115000>;
				hysteresis = <3000>;
				type = "critical";
			};

			cpu6_alert0: trip-point1 {
				temperature = <114000>;
				hysteresis = <3000>;
			};
		};

		cooling-maps {
			map0 {
				trip = <&cpu6_alert0>;
				cooling-device = <&CPU6_idle 100 100>;
			};
		};
	};

	cpu-1-1-0 {
		trips {
			trip-point2 {
				temperature = <115000>;
				hysteresis = <3000>;
				type = "critical";
			};

			cpu7_alert0: trip-point1 {
				temperature = <114000>;
				hysteresis = <3000>;
			};
		};

		cooling-maps {
			map0 {
				trip = <&cpu7_alert0>;
				cooling-device = <&CPU7_idle 100 100>;
			};
		};
	};

	cpu-1-2-0 {
		trips {
			trip-point2 {
				temperature = <115000>;
				hysteresis = <3000>;
				type = "critical";
			};

			cpu8_alert0: trip-point1 {
				temperature = <114000>;
				hysteresis = <3000>;
			};
		};

		cooling-maps {
			map0 {
				trip = <&cpu8_alert0>;
				cooling-device = <&CPU8_idle 100 100>;
			};
		};
	};

	cpu-1-3-0 {
		trips {
			trip-point2 {
				temperature = <115000>;
				hysteresis = <3000>;
				type = "critical";
			};

			cpu9_alert0: trip-point1 {
				temperature = <114000>;
				hysteresis = <3000>;
			};
		};

		cooling-maps {
			map0 {
				trip = <&cpu9_alert0>;
				cooling-device = <&CPU9_idle 100 100>;
			};
		};
	};

	cpu-1-4-0 {
		trips {
			trip-point2 {
				temperature = <115000>;
				hysteresis = <3000>;
				type = "critical";
			};

			cpu10_alert0: trip-point1 {
				temperature = <114000>;
				hysteresis = <3000>;
			};
		};

		cooling-maps {
			map0 {
				trip = <&cpu10_alert0>;
				cooling-device = <&CPU10_idle 100 100>;
			};
		};
	};

	cpu-1-5-0 {
		trips {
			trip-point2 {
				temperature = <115000>;
				hysteresis = <3000>;
				type = "critical";
			};

			cpu11_alert0: trip-point1 {
				temperature = <114000>;
				hysteresis = <3000>;
			};
		};

		cooling-maps {
			map0 {
				trip = <&cpu11_alert0>;
				cooling-device = <&CPU11_idle 100 100>;
			};
		};
	};

	cpullc-1-0 {
		trips {
			trip-point2 {
				temperature = <115000>;
				hysteresis = <3000>;
				type = "critical";
			};
		};
	};

	ddr-1-0 {
		trips {
			trip-point2 {
				temperature = <115000>;
				hysteresis = <3000>;
				type = "critical";
			};
		};
	};

	ddr-0-1 {
		trips {
			trip-point2 {
				temperature = <115000>;
				hysteresis = <3000>;
				type = "critical";
			};
		};
	};

	cpu-0-0-1 {
		trips {
			trip-point2 {
				temperature = <115000>;
				hysteresis = <3000>;
				type = "critical";
			};
		};
	};

	cpu-0-1-1 {
		trips {
			trip-point2 {
				temperature = <115000>;
				hysteresis = <3000>;
				type = "critical";
			};

			cpu1_alert1: trip-point1 {
				temperature = <114000>;
				hysteresis = <3000>;
			};
		};

		cooling-maps {
			map0 {
				trip = <&cpu1_alert1>;
				cooling-device = <&CPU1_idle 100 100>;
			};
		};
	};

	cpu-0-2-1 {
		trips {
			trip-point2 {
				temperature = <115000>;
				hysteresis = <3000>;
				type = "critical";
			};

			cpu2_alert1: trip-point1 {
				temperature = <114000>;
				hysteresis = <3000>;
			};
		};

		cooling-maps {
			map0 {
				trip = <&cpu2_alert1>;
				cooling-device = <&CPU2_idle 100 100>;
			};
		};
	};

	cpu-0-3-1 {
		trips {
			trip-point2 {
				temperature = <115000>;
				hysteresis = <3000>;
				type = "critical";
			};

			cpu3_alert1: trip-point1 {
				temperature = <114000>;
				hysteresis = <3000>;
			};
		};

		cooling-maps {
			map0 {
				trip = <&cpu3_alert1>;
				cooling-device = <&CPU3_idle 100 100>;
			};
		};
	};

	cpu-0-4-1 {
		trips {
			trip-point2 {
				temperature = <115000>;
				hysteresis = <3000>;
				type = "critical";
			};

			cpu4_alert1: trip-point1 {
				temperature = <114000>;
				hysteresis = <3000>;
			};
		};

		cooling-maps {
			map0 {
				trip = <&cpu4_alert1>;
				cooling-device = <&CPU4_idle 100 100>;
			};
		};
	};

	cpu-0-5-1 {
		trips {
			trip-point2 {
				temperature = <115000>;
				hysteresis = <3000>;
				type = "critical";
			};

			cpu5_alert1: trip-point1 {
				temperature = <114000>;
				hysteresis = <3000>;
			};
		};

		cooling-maps {
			map0 {
				trip = <&cpu5_alert1>;
				cooling-device = <&CPU5_idle 100 100>;
			};
		};
	};

	cpullc-0-1 {
		trips {
			trip-point2 {
				temperature = <115000>;
				hysteresis = <3000>;
				type = "critical";
			};
		};
	};

	cpu-1-0-1 {
		trips {
			trip-point2 {
				temperature = <115000>;
				hysteresis = <3000>;
				type = "critical";
			};

			cpu6_alert1: trip-point1 {
				temperature = <114000>;
				hysteresis = <3000>;

			};
		};

		cooling-maps {
			map0 {
				trip = <&cpu6_alert1>;
				cooling-device = <&CPU6_idle 100 100>;
			};
		};
	};

	cpu-1-1-1 {
		trips {
			trip-point2 {
				temperature = <115000>;
				hysteresis = <3000>;
				type = "critical";
			};

			cpu7_alert1: trip-point1 {
				temperature = <114000>;
				hysteresis = <3000>;
			};
		};

		cooling-maps {
			map0 {
				trip = <&cpu7_alert1>;
				cooling-device = <&CPU7_idle 100 100>;
			};
		};
	};

	cpu-1-2-1 {
		trips {
			trip-point2 {
				temperature = <115000>;
				hysteresis = <3000>;
				type = "critical";
			};

			cpu8_alert1: trip-point1 {
				temperature = <114000>;
				hysteresis = <3000>;
			};
		};

		cooling-maps {
			map0 {
				trip = <&cpu8_alert1>;
				cooling-device = <&CPU8_idle 100 100>;
			};
		};
	};

	cpu-1-3-1 {
		trips {
			trip-point2 {
				temperature = <115000>;
				hysteresis = <3000>;
				type = "critical";
			};

			cpu9_alert1: trip-point1 {
				temperature = <114000>;
				hysteresis = <3000>;
			};
		};

		cooling-maps {
			map0 {
				trip = <&cpu9_alert1>;
				cooling-device = <&CPU9_idle 100 100>;
			};
		};
	};

	cpu-1-4-1 {
		trips {
			trip-point2 {
				temperature = <115000>;
				hysteresis = <3000>;
				type = "critical";
			};

			cpu10_alert1: trip-point1 {
				temperature = <114000>;
				hysteresis = <3000>;
			};
		};

		cooling-maps {
			map0 {
				trip = <&cpu10_alert1>;
				cooling-device = <&CPU10_idle 100 100>;
			};
		};
	};

	cpu-1-5-1 {
		trips {
			trip-point2 {
				temperature = <115000>;
				hysteresis = <3000>;
				type = "critical";
			};

			cpu11_alert1: trip-point1 {
				temperature = <114000>;
				hysteresis = <3000>;
			};
		};

		cooling-maps {
			map0 {
				trip = <&cpu11_alert1>;
				cooling-device = <&CPU11_idle 100 100>;
			};
		};
	};

	cpullc-1-1 {
		trips {
			trip-point2 {
				temperature = <115000>;
				hysteresis = <3000>;
				type = "critical";
			};
		};
	};

	ddr-1-1 {
		trips {
			trip-point2 {
				temperature = <115000>;
				hysteresis = <3000>;
				type = "critical";
			};
		};
	};

	amux-2 {
		trips {
			trip-point2 {
				temperature = <115000>;
				hysteresis = <3000>;
				type = "critical";
			};
		};
	};

	cpu-2-0-0 {
		trips {
			trip-point2 {
				temperature = <115000>;
				hysteresis = <3000>;
				type = "critical";
			};

			cpu12_alert0: trip-point1 {
				temperature = <114000>;
				hysteresis = <3000>;
			};
		};

		cooling-maps {
			map0 {
				trip = <&cpu12_alert0>;
				cooling-device = <&CPU12_idle 100 100>;
			};
		};
	};

	cpu-2-1-0 {
		trips {
			trip-point2 {
				temperature = <115000>;
				hysteresis = <3000>;
				type = "critical";
			};

			cpu13_alert0: trip-point1 {
				temperature = <114000>;
				hysteresis = <3000>;
			};
		};

		cooling-maps {
			map0 {
				trip = <&cpu13_alert0>;
				cooling-device = <&CPU13_idle 100 100>;
			};
		};
	};

	cpu-2-2-0 {
		trips {
			trip-point2 {
				temperature = <115000>;
				hysteresis = <3000>;
				type = "critical";
			};

			cpu14_alert0: trip-point1 {
				temperature = <114000>;
				hysteresis = <3000>;
			};
		};

		cooling-maps {
			map0 {
				trip = <&cpu14_alert0>;
				cooling-device = <&CPU14_idle 100 100>;
			};
		};
	};

	cpu-2-3-0 {
		trips {
			trip-point2 {
				temperature = <115000>;
				hysteresis = <3000>;
				type = "critical";
			};

			cpu15_alert0: trip-point1 {
				temperature = <114000>;
				hysteresis = <3000>;
			};
		};

		cooling-maps {
			map0 {
				trip = <&cpu15_alert0>;
				cooling-device = <&CPU15_idle 100 100>;
			};
		};
	};

	cpu-2-4-0 {
		trips {
			trip-point2 {
				temperature = <115000>;
				hysteresis = <3000>;
				type = "critical";
			};

			cpu16_alert0: trip-point1 {
				temperature = <114000>;
				hysteresis = <3000>;
			};
		};

		cooling-maps {
			map0 {
				trip = <&cpu16_alert0>;
				cooling-device = <&CPU16_idle 100 100>;
			};
		};
	};

	cpu-2-5-0 {
		trips {
			trip-point2 {
				temperature = <115000>;
				hysteresis = <3000>;
				type = "critical";
			};

			cpu17_alert0: trip-point1 {
				temperature = <114000>;
				hysteresis = <3000>;
			};
		};

		cooling-maps {
			map0 {
				trip = <&cpu17_alert0>;
				cooling-device = <&CPU17_idle 100 100>;
			};
		};
	};

	cpullc-2-0 {
		trips {
			trip-point2 {
				temperature = <115000>;
				hysteresis = <3000>;
				type = "critical";
			};
		};
	};

	audiohvx-0-0 {
		trips {
			trip-point2 {
				temperature = <115000>;
				hysteresis = <3000>;
				type = "critical";
			};
		};
	};

	audiohmx-0-0 {
		trips {
			trip-point2 {
				temperature = <115000>;
				hysteresis = <3000>;
				type = "critical";
			};
		};
	};

	audiohvx-1-0 {
		trips {
			trip-point2 {
				temperature = <115000>;
				hysteresis = <3000>;
				type = "critical";
			};
		};
	};

	audiohmx-1-0 {
		trips {
			trip-point2 {
				temperature = <115000>;
				hysteresis = <3000>;
				type = "critical";
			};
		};
	};

	audiohvx-2-0 {
		trips {
			trip-point2 {
				temperature = <115000>;
				hysteresis = <3000>;
				type = "critical";
			};
		};
	};

	audiohmx-2-0 {
		trips {
			trip-point2 {
				temperature = <115000>;
				hysteresis = <3000>;
				type = "critical";
			};
		};
	};

	pcie-0 {
		trips {
			trip-point2 {
				temperature = <115000>;
				hysteresis = <3000>;
				type = "critical";
			};
		};
	};

	amux-3 {
		trips {
			trip-point2 {
				temperature = <115000>;
				hysteresis = <3000>;
				type = "critical";
			};
		};
	};

	cpu-2-0-1 {
		trips {
			trip-point2 {
				temperature = <115000>;
				hysteresis = <3000>;
				type = "critical";
			};

			cpu12_alert1: trip-point1 {
				temperature = <114000>;
				hysteresis = <3000>;
			};
		};

		cooling-maps {
			map0 {
				trip = <&cpu12_alert1>;
				cooling-device = <&CPU12_idle 100 100>;
			};
		};
	};

	cpu-2-1-1 {
		trips {
			trip-point2 {
				temperature = <115000>;
				hysteresis = <3000>;
				type = "critical";
			};

			cpu13_alert1: trip-point1 {
				temperature = <114000>;
				hysteresis = <3000>;
			};
		};

		cooling-maps {
			map0 {
				trip = <&cpu13_alert1>;
				cooling-device = <&CPU13_idle 100 100>;
			};
		};
	};

	cpu-2-2-1 {
		trips {
			trip-point2 {
				temperature = <115000>;
				hysteresis = <3000>;
				type = "critical";
			};

			cpu14_alert1: trip-point1 {
				temperature = <114000>;
				hysteresis = <3000>;
			};
		};

		cooling-maps {
			map0 {
				trip = <&cpu14_alert1>;
				cooling-device = <&CPU14_idle 100 100>;
			};
		};
	};

	cpu-2-3-1 {
		trips {
			trip-point2 {
				temperature = <115000>;
				hysteresis = <3000>;
				type = "critical";
			};

			cpu15_alert1: trip-point1 {
				temperature = <114000>;
				hysteresis = <3000>;
			};
		};

		cooling-maps {
			map0 {
				trip = <&cpu15_alert1>;
				cooling-device = <&CPU15_idle 100 100>;
			};
		};
	};

	cpu-2-4-1 {
		trips {
			trip-point2 {
				temperature = <115000>;
				hysteresis = <3000>;
				type = "critical";
			};

			cpu16_alert1: trip-point1 {
				temperature = <114000>;
				hysteresis = <3000>;
			};
		};

		cooling-maps {
			map0 {
				trip = <&cpu16_alert1>;
				cooling-device = <&CPU16_idle 100 100>;
			};
		};
	};

	cpu-2-5-1 {
		trips {
			trip-point2 {
				temperature = <115000>;
				hysteresis = <3000>;
				type = "critical";
			};

			cpu17_alert1: trip-point1 {
				temperature = <114000>;
				hysteresis = <3000>;
			};
		};

		cooling-maps {
			map0 {
				trip = <&cpu17_alert1>;
				cooling-device = <&CPU17_idle 100 100>;
			};
		};
	};

	cpullc-2-1 {
		trips {
			trip-point2 {
				temperature = <115000>;
				hysteresis = <3000>;
				type = "critical";
			};
		};
	};

	audiohvx-0-1 {
		trips {
			trip-point2 {
				temperature = <115000>;
				hysteresis = <3000>;
				type = "critical";
			};
		};
	};

	audiohmx-0-1 {
		trips {
			trip-point2 {
				temperature = <115000>;
				hysteresis = <3000>;
				type = "critical";
			};
		};
	};

	audiohvx-1-1 {
		trips {
			trip-point2 {
				temperature = <115000>;
				hysteresis = <3000>;
				type = "critical";
			};
		};
	};

	audiohmx-1-1 {
		trips {
			trip-point2 {
				temperature = <115000>;
				hysteresis = <3000>;
				type = "critical";
			};
		};
	};

	audiohvx-2-1 {
		trips {
			trip-point2 {
				temperature = <115000>;
				hysteresis = <3000>;
				type = "critical";
			};
		};
	};

	audiohmx-2-1 {
		trips {
			trip-point2 {
				temperature = <115000>;
				hysteresis = <3000>;
				type = "critical";
			};
		};
	};

	pcie-1 {
		trips {
			trip-point2 {
				temperature = <115000>;
				hysteresis = <3000>;
				type = "critical";
			};
		};
	};

	nsphvx-0-0 {
		trips {
			trip-point2 {
				temperature = <115000>;
				hysteresis = <3000>;
				type = "critical";
			};
		};
	};

	nsphvx-0-2 {
		trips {
			trip-point2 {
				temperature = <115000>;
				hysteresis = <3000>;
				type = "critical";
			};
		};
	};

	nsphmx-0-0-0 {
		trips {
			trip-point2 {
				temperature = <115000>;
				hysteresis = <3000>;
				type = "critical";
			};
		};
	};

	nsphmx-0-1-0 {
		trips {
			trip-point2 {
				temperature = <115000>;
				hysteresis = <3000>;
				type = "critical";
			};
		};
	};

	nsphvx-1-0 {
		trips {
			trip-point2 {
				temperature = <115000>;
				hysteresis = <3000>;
				type = "critical";
			};
		};
	};

	nsphvx-1-2 {
		trips {
			trip-point2 {
				temperature = <115000>;
				hysteresis = <3000>;
				type = "critical";
			};
		};
	};

	nsphmx-1-0-0 {
		trips {
			trip-point2 {
				temperature = <115000>;
				hysteresis = <3000>;
				type = "critical";
			};
		};
	};

	nsphmx-1-1-0 {
		trips {
			trip-point2 {
				temperature = <115000>;
				hysteresis = <3000>;
				type = "critical";
			};
		};
	};

	nsphvx-2-0 {
		trips {
			trip-point2 {
				temperature = <115000>;
				hysteresis = <3000>;
				type = "critical";
			};
		};
	};

	nsphvx-2-2 {
		trips {
			trip-point2 {
				temperature = <115000>;
				hysteresis = <3000>;
				type = "critical";
			};
		};
	};

	nsphmx-2-0-0 {
		trips {
			trip-point2 {
				temperature = <115000>;
				hysteresis = <3000>;
				type = "critical";
			};
		};
	};

	nsphmx-2-1-0 {
		trips {
			trip-point2 {
				temperature = <115000>;
				hysteresis = <3000>;
				type = "critical";
			};
		};
	};

	nsphvx-3-0 {
		trips {
			trip-point2 {
				temperature = <115000>;
				hysteresis = <3000>;
				type = "critical";
			};
		};
	};

	nsphvx-3-2 {
		trips {
			trip-point2 {
				temperature = <115000>;
				hysteresis = <3000>;
				type = "critical";
			};
		};
	};

	nsphmx-3-0-0 {
		trips {
			trip-point2 {
				temperature = <115000>;
				hysteresis = <3000>;
				type = "critical";
			};
		};
	};

	nsphmx-3-1-0 {
		trips {
			trip-point2 {
				temperature = <115000>;
				hysteresis = <3000>;
				type = "critical";
			};
		};
	};

	nsphvx-0-1 {
		trips {
			trip-point2 {
				temperature = <115000>;
				hysteresis = <3000>;
				type = "critical";
			};
		};
	};

	nsphvx-0-3 {
		trips {
			trip-point2 {
				temperature = <115000>;
				hysteresis = <3000>;
				type = "critical";
			};
		};
	};

	nsphmx-0-0-1 {
		trips {
			trip-point2 {
				temperature = <115000>;
				hysteresis = <3000>;
				type = "critical";
			};
		};
	};

	nsphmx-0-1-1 {
		trips {
			trip-point2 {
				temperature = <115000>;
				hysteresis = <3000>;
				type = "critical";
			};
		};
	};

	nsphvx-1-1 {
		trips {
			trip-point2 {
				temperature = <115000>;
				hysteresis = <3000>;
				type = "critical";
			};
		};
	};

	nsphvx-1-3 {
		trips {
			trip-point2 {
				temperature = <115000>;
				hysteresis = <3000>;
				type = "critical";
			};
		};
	};

	nsphmx-1-0-1 {
		trips {
			trip-point2 {
				temperature = <115000>;
				hysteresis = <3000>;
				type = "critical";
			};
		};
	};

	nsphmx-1-1-1 {
		trips {
			trip-point2 {
				temperature = <115000>;
				hysteresis = <3000>;
				type = "critical";
			};
		};
	};

	nsphvx-2-1 {
		trips {
			trip-point2 {
				temperature = <115000>;
				hysteresis = <3000>;
				type = "critical";
			};
		};
	};

	nsphvx-2-3 {
		trips {
			trip-point2 {
				temperature = <115000>;
				hysteresis = <3000>;
				type = "critical";
			};
		};
	};

	nsphmx-2-0-1 {
		trips {
			trip-point2 {
				temperature = <115000>;
				hysteresis = <3000>;
				type = "critical";
			};
		};
	};

	nsphmx-2-1-1 {
		trips {
			trip-point2 {
				temperature = <115000>;
				hysteresis = <3000>;
				type = "critical";
			};
		};
	};

	nsphvx-3-1 {
		trips {
			trip-point2 {
				temperature = <115000>;
				hysteresis = <3000>;
				type = "critical";
			};
		};
	};

	nsphvx-3-3 {
		trips {
			trip-point2 {
				temperature = <115000>;
				hysteresis = <3000>;
				type = "critical";
			};
		};
	};

	nsphmx-3-0-1 {
		trips {
			trip-point2 {
				temperature = <115000>;
				hysteresis = <3000>;
				type = "critical";
			};
		};
	};

	nsphmx-3-1-1 {
		trips {
			trip-point2 {
				temperature = <115000>;
				hysteresis = <3000>;
				type = "critical";
			};
		};
	};

	amux-6 {
		trips {
			trip-point2 {
				temperature = <115000>;
				hysteresis = <3000>;
				type = "critical";
			};
		};
	};

	gpuss-0-0-0-0 {
		trips {
			trip-point2 {
				temperature = <115000>;
				hysteresis = <3000>;
				type = "critical";
			};
		};
	};

	gpuss-0-1-0-0 {
		trips {
			trip-point2 {
				temperature = <115000>;
				hysteresis = <3000>;
				type = "critical";
			};
		};
	};

	gpuss-0-2-0-0 {
		trips {
			trip-point2 {
				temperature = <115000>;
				hysteresis = <3000>;
				type = "critical";
			};
		};
	};

	gpucore-0-0-0 {
		trips {
			trip-point2 {
				temperature = <115000>;
				hysteresis = <3000>;
				type = "critical";
			};
		};
	};

	gpuss-1-0 {
		trips {
			trip-point2 {
				temperature = <115000>;
				hysteresis = <3000>;
				type = "critical";
			};
		};
	};

	gpuss-1-1 {
		trips {
			trip-point2 {
				temperature = <115000>;
				hysteresis = <3000>;
				type = "critical";
			};
		};
	};

	cv-0 {
		trips {
			trip-point2 {
				temperature = <115000>;
				hysteresis = <3000>;
				type = "critical";
			};
		};
	};

	video-0 {
		trips {
			trip-point2 {
				temperature = <115000>;
				hysteresis = <3000>;
				type = "critical";
			};
		};
	};

	camera-1 {
		trips {
			trip-point2 {
				temperature = <115000>;
				hysteresis = <3000>;
				type = "critical";
			};
		};
	};

	ddr-2-0 {
		trips {
			trip-point2 {
				temperature = <115000>;
				hysteresis = <3000>;
				type = "critical";
			};
		};
	};

	ddr-3-0 {
		trips {
			trip-point2 {
				temperature = <115000>;
				hysteresis = <3000>;
				type = "critical";
			};
		};
	};

	gpuss-0-0-1-1 {
		trips {
			trip-point2 {
				temperature = <115000>;
				hysteresis = <3000>;
				type = "critical";
			};
		};
	};

	gpuss-0-1-1-1 {
		trips {
			trip-point2 {
				temperature = <115000>;
				hysteresis = <3000>;
				type = "critical";
			};
		};
	};

	gpuss-0-2-1-1 {
		trips {
			trip-point2 {
				temperature = <115000>;
				hysteresis = <3000>;
				type = "critical";
			};
		};
	};

	gpucore-0-1-1 {
		trips {
			trip-point2 {
				temperature = <115000>;
				hysteresis = <3000>;
				type = "critical";
			};
		};
	};

	amux-7 {
		trips {
			trip-point2 {
				temperature = <115000>;
				hysteresis = <3000>;
				type = "critical";
			};
		};
	};

	gpuss-0-0-1-0 {
		trips {
			trip-point2 {
				temperature = <115000>;
				hysteresis = <3000>;
				type = "critical";
			};
		};
	};

	gpuss-0-1-1-0 {
		trips {
			trip-point2 {
				temperature = <115000>;
				hysteresis = <3000>;
				type = "critical";
			};
		};
	};

	gpuss-0-2-1-0 {
		trips {
			trip-point2 {
				temperature = <115000>;
				hysteresis = <3000>;
				type = "critical";
			};
		};
	};

	gpucore-0-1-0 {
		trips {
			trip-point2 {
				temperature = <115000>;
				hysteresis = <3000>;
				type = "critical";
			};
		};
	};

	gpuss-1-2 {
		trips {
			trip-point2 {
				temperature = <115000>;
				hysteresis = <3000>;
				type = "critical";
			};
		};
	};

	gpucore-1-0 {
		trips {
			trip-point2 {
				temperature = <115000>;
				hysteresis = <3000>;
				type = "critical";
			};
		};
	};

	cv-1 {
		trips {
			trip-point2 {
				temperature = <115000>;
				hysteresis = <3000>;
				type = "critical";
			};
		};
	};

	video-1 {
		trips {
			trip-point2 {
				temperature = <115000>;
				hysteresis = <3000>;
				type = "critical";
			};
		};
	};

	camera-2 {
		trips {
			trip-point2 {
				temperature = <115000>;
				hysteresis = <3000>;
				type = "critical";
			};
		};
	};

	ddr-2-1 {
		trips {
			trip-point2 {
				temperature = <115000>;
				hysteresis = <3000>;
				type = "critical";
			};
		};
	};

	ddr-3-1 {
		trips {
			trip-point2 {
				temperature = <115000>;
				hysteresis = <3000>;
				type = "critical";
			};
		};
	};

	gpuss-0-0-0-1 {
		trips {
			trip-point2 {
				temperature = <115000>;
				hysteresis = <3000>;
				type = "critical";
			};
		};
	};

	gpuss-0-1-0-1 {
		trips {
			trip-point2 {
				temperature = <115000>;
				hysteresis = <3000>;
				type = "critical";
			};
		};
	};

	gpuss-0-2-0-1 {
		trips {
			trip-point2 {
				temperature = <115000>;
				hysteresis = <3000>;
				type = "critical";
			};
		};
	};

	gpucore-0-0-1 {
		trips {
			trip-point2 {
				temperature = <115000>;
				hysteresis = <3000>;
				type = "critical";
			};
		};
	};

	pm-e-die-temp {
		cooling-maps {
			map0 {
				trip = <&kai_e_trip1>;
				cooling-device = <&CPU0 0 0>;
			};
		};
	};

	pm-f-die-temp {
		cooling-maps {
			map0 {
				trip = <&kai_f_trip1>;
				cooling-device = <&CPU0 0 0>;
			};
		};
	};

	pm-g-die-temp {
		cooling-maps {
			map0 {
				trip = <&kai_g_trip1>;
				cooling-device = <&CPU0 0 0>;
			};
		};
	};

	pm-h-die-temp {
		cooling-maps {
			map0 {
				trip = <&kai_h_trip1>;
				cooling-device = <&CPU0 0 0>;
			};
		};
	};

	pm-i-die-temp {
		cooling-maps {
			map0 {
				trip = <&kai_i_trip1>;
				cooling-device = <&CPU0 0 0>;
			};
		};
	};

	pm-l-die-temp {
		cooling-maps {
			map0 {
				trip = <&kai_l_trip1>;
				cooling-device = <&CPU0 0 0>;
			};
		};
	};

	pm-j-die-temp {
		cooling-maps {
			map0 {
				trip = <&kai_j_trip1>;
				cooling-device = <&CPU0 3 THERMAL_NO_LIMIT>;
			};
		};
	};

	pm-k-die-temp {
		cooling-maps {
			map0 {
				trip = <&kai_k_trip1>;
				cooling-device = <&CPU6 3 THERMAL_NO_LIMIT>;
			};

			map1 {
				trip = <&kai_k_trip1>;
				cooling-device = <&CPU12 3 THERMAL_NO_LIMIT>;
			};
		};
	};

	pm-a-die-temp {
		cooling-maps {
			map0 {
				trip = <&pm_kobra_trip1>;
				cooling-device = <&CPU0 3 THERMAL_NO_LIMIT>;
			};

			map1 {
				trip = <&pm_kobra_trip1>;
				cooling-device = <&CPU6 3 THERMAL_NO_LIMIT>;
			};

			map2 {
				trip = <&pm_kobra_trip1>;
				cooling-device = <&CPU12 3 THERMAL_NO_LIMIT>;
			};
		};
	};
};
