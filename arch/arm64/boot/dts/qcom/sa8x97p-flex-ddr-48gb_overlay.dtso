// SPDX-License-Identifier: BSD-3-Clause
/*
 * Copyright (c) Qualcomm Technologies, Inc. and/or its subsidiaries.
 */

/dts-v1/;
/plugin/;


/ {
	compatible = "qcom,sa8x97p-flex-ride-sx";
};

&{/} {
	qcom,sku-id = <0x301>;
};

&non_ecc_heap_mem {
	reg = <0x88 0x00000000 0x2 0xBF000000>;
	status = "okay";
};

&qcipc_pvm_nonsafe_mem {
	reg = <0x8A 0xBF000000 0x0 0x01000000>;
	status = "okay";
};
