// SPDX-License-Identifier: BSD-3-Clause
/*
 * Copyright (c) Qualcomm Technologies, Inc. and/or its subsidiaries.
 */

/ {
	model = "Qualcomm Technologies, Inc. QAM8397P SIP";
	compatible = "qcom,sa8397p-qam","qcom,sa8397p";
	qcom,msm-id = <689 0x10000>, <689 0x10001>;
};

