// SPDX-License-Identifier: BSD-3-Clause
/*
 * Copyright (c) Qualcomm Technologies, Inc. and/or its subsidiaries.
 */

/dts-v1/;
/plugin/;

#include "sa8x97p-flex-ddr-32gb-vms.dtsi"

&non_ecc_heap_mem {
	reg = <0xA 0x60000000 0x1 0x00000000>;
	status = "okay";
};
