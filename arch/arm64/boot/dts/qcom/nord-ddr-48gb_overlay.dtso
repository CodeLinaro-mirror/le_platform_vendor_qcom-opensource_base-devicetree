// SPDX-License-Identifier: BSD-3-Clause
/*
 * Copyright (c) Qualcomm Technologies, Inc. and/or its subsidiaries.
 */

/dts-v1/;
/plugin/;

/ {
	compatible = "qcom,nord-ride", "qcom,nord";
};

#include "nord-ddr-48gb-vms.dtsi"

&non_ecc_heap_mem {
	reg = <0x89 0xC0000000 0x1 0x00000000>;
	status = "okay";
};
