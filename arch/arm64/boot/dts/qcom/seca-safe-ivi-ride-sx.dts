// SPDX-License-Identifier: BSD-3-Clause
/*
 * Copyright (c) Qualcomm Technologies, Inc. and/or its subsidiaries.
 */

/dts-v1/;

#include "seca.dtsi"

/ {
	model = "Qualcomm Technologies, Inc. SECA SAFE IVI RIDE-SX";
	compatible = "qcom,seca-ride-sx", "qcom,safe-ivi", "qcom,seca";
	qcom,board-id = <0x01010025 1>;
	qcom,sku-id = <0x200>;
};

&pcie0 {
	power-domains = <&scmi5_pd 0>;
	power-domain-names = "power";
};

&pcie1 {
	power-domains = <&scmi6_pd 0>;
	power-domain-names = "power";
};
