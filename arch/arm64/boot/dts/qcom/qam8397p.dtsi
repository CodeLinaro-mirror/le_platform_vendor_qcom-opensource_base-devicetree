// SPDX-License-Identifier: BSD-3-Clause
/*
 * Copyright (c) 2024 Qualcomm Innovation Center, Inc. All rights reserved.
 */

/ {
	model = "Qualcomm Technologies, Inc. QAM8397P SIP";
	compatible = "qcom,sa8397p-qam","qcom,sa8397p";
	qcom,msm-id = <689 0x10000>;
};

