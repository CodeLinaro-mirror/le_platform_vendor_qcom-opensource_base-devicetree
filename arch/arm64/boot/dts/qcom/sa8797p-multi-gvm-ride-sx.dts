// SPDX-License-Identifier: BSD-3-Clause
/*
 * Copyright (c) Qualcomm Technologies, Inc. and/or its subsidiaries.
 */

/dts-v1/;

#include "sa8x97p.dtsi"
#include "sa8797p.dtsi"
#include "sa8x97p-multi-gvm.dtsi"

/ {
	model = "Qualcomm Technologies, Inc. SA8797p";
	compatible = "qcom,sa8797p";
	qcom,board-id = <0x01010025 1>;
};
