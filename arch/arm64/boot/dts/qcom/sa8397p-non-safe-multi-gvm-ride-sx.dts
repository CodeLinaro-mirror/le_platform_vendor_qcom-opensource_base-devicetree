// SPDX-License-Identifier: BSD-3-Clause
/*
 * Copyright (c) Qualcomm Technologies, Inc. and/or its subsidiaries.
 */

/dts-v1/;

#include "sa8x97p.dtsi"
#include "sa8397p.dtsi"
#include "sa8x97p-non-safe.dtsi"

/ {
	model = "Qualcomm Technologies, Inc. SA3797p RIDE-SX";
	compatible = "qcom,non-safe", "qcom,sa3797p";
	qcom,board-id = <0x01010025 1>;
};
