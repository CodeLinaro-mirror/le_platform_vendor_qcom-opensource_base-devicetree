// SPDX-License-Identifier: BSD-3-Clause
/*
 * Copyright (c) Qualcomm Technologies, Inc. and/or its subsidiaries.
 */

/dts-v1/;

#include "sa8x97p.dtsi"
#include "sa8397p.dtsi"
#include "sa8x97p-multi-gvm.dtsi"

/ {
	model = "Qualcomm Technologies, Inc. SA8397P MULTI GVM RIDE-SX";
	compatible = "qcom,sa8397p";
	qcom,board-id = <0x01010025 1>;
	qcom,sku-id = <0x200>;
};

&ethernet0 {
	phy-mode = "10gbase-r";

	fixed-link {
		status = "okay";
		speed = <10000>;
		full-duplex;
	};
};
