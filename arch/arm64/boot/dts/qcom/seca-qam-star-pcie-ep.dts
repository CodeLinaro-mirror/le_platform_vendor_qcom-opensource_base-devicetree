// SPDX-License-Identifier: BSD-3-Clause
/*
 * Copyright (c) Qualcomm Technologies, Inc. and/or its subsidiaries.
 */

/dts-v1/;

#include "seca.dtsi"
#include "seca-safe.dtsi"

/ {
	model = "Qualcomm Technologies, Inc. SECA QAM STAR PCIe EP";
	compatible = "qcom,seca-qam-star", "qcom,qam", "qcom,seca";
	qcom,board-id = <0x04010025 4>;
};

&pcie0_ep {
	power-domains = <&scmi5_pd 1>;
	power-domain-names = "power";
	status = "okay";
};
