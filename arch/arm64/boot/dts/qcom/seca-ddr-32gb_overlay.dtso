// SPDX-License-Identifier: BSD-3-Clause
/*
 * Copyright (c) Qualcomm Technologies, Inc. and/or its subsidiaries.
 */

/dts-v1/;
/plugin/;

#include "seca-ddr-32gb-vms.dtsi"

/ {
	compatible = "qcom,seca-ride-sx", "qcom,seca-qam-ride-sx", "qcom,seca-adp-star";
};
