// SPDX-License-Identifier: BSD-3-Clause
/*
 * Copyright (c) Qualcomm Technologies, Inc. and/or its subsidiaries.
 */

/dts-v1/;
/plugin/;


/ {
	compatible = "qcom,sa8x97p-adp-star", "qcom,sa8x97p-ride-sx", "qcom,sa8x97p-qam-ride-sx";
};

&{/} {
	qcom,sku-id = <0x1 0x201>;
};

&non_ecc_heap_mem {
	reg = <0xA 0x20000000 0x1 0x3F000000>;
	status = "okay";
};

&qcipc_pvm_nonsafe_mem {
	reg = <0xB 0x5F000000 0x0 0x01000000>;
	status = "okay";
};
