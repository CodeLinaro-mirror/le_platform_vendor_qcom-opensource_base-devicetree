// SPDX-License-Identifier: BSD-3-Clause
/*
 * Copyright (c) 2024 Qualcomm Innovation Center, Inc. All rights reserved.
 */

#include "sa8797p-overlay.dtso"

/ {
	model = "Qualcomm SA8397";
	compatible = "qcom,sa8397p";
};
